#include "config.h"
#include "legs.h"
#include <math.h>
#include "control.h"

Leg leftLeg;
Leg rightLeg;
float legPos = 0;
void Leg_TurnTask (void * args);


void Leg_Init(Leg *leg, Motor *frontJoint, Motor *behindJoint, Motor *wheel)
{
    leg->frontJoint = frontJoint;
    leg->behindJoint = behindJoint;
    leg->wheel = wheel;
    leg->wheelPos_x = 0;
    leg->wheelPos_y = 0;
}


void Leg_InitAll(void)
{
    Leg_Init(&leftLeg, &leftJoint[1], &leftJoint[0], &leftWheel);
    Leg_Init(&rightLeg, &rightJoint[1], &rightJoint[0], &rightWheel);
    xTaskCreate(Leg_TurnTask, "Leg_TurnTask", 2048, NULL, 3, NULL);
   
}


void Leg_TurnTask(void * args)
{
    float rato = 80;
    float fllowPos_left = Leg_GetPosition(&leftLeg);
    float fllowPos_right = Leg_GetPosition(&rightLeg);
    while(1){
        if(workState == STATE_JUMP){
            vTaskDelay(5);
            continue;;
        } 
        if(fllowPos_left < Leg_GetPosition(&leftLeg)){
            fllowPos_left += fabs(Leg_GetPosition(&leftLeg) - fllowPos_left)/rato;
        }
        else if(fllowPos_left > Leg_GetPosition(&leftLeg)){
            fllowPos_left -= fabs(Leg_GetPosition(&leftLeg) - fllowPos_left)/rato;
        }

        if(fllowPos_right < Leg_GetPosition(&rightLeg)){
            fllowPos_right += fabs(Leg_GetPosition(&rightLeg) - fllowPos_right)/rato;
        }
        else if(fllowPos_right > Leg_GetPosition(&rightLeg)){
            fllowPos_right -= fabs(Leg_GetPosition(&rightLeg) - fllowPos_right)/rato;
        }

        Leg_UpdateData(&leftLeg, fllowPos_left);
        Leg_UpdateData(&rightLeg, fllowPos_right);
  
        vTaskDelay(5);
    }

}

void Leg_SetPosition(Leg *leg, float pos)
{
   leg->pos = pos;
}

float Leg_GetPosition(Leg* leg)
{
    return leg->pos;
}

void Leg_UpdateData(Leg *leg, float pos)
{
    float frontJoint_Pos;
    float BehindJoint_Pos;
   
    frontJoint_Pos = pos;
   
    frontJoint_Pos = frontJoint_Pos > M_PI_2 ? M_PI_2 : frontJoint_Pos;
    frontJoint_Pos = frontJoint_Pos < 0 ? 0 : frontJoint_Pos;

    BehindJoint_Pos = -frontJoint_Pos;
  
    leg->frontJoint->position = frontJoint_Pos;
    leg->behindJoint->position = BehindJoint_Pos;

    Motor_SetPosition(leg->frontJoint, leg->frontJoint->position);
    Motor_SetPosition(leg->behindJoint, leg->behindJoint->position);
}

void leg_pos(float phi1, float phi4, float pos[2])
{
  float a;
  float b_a;
  float t14;
  float t15;
  float t2;
  float t3;
  float t4;
  float t5;
  float t6;
  float t8_tmp;
  /*     This function was generated by the Symbolic Math Toolbox version 9.2.
   */
  /*     27-Jan-2023 19:36:58 */
  t2 = cosf(phi1);
  t3 = cosf(phi4);
  t4 = sinf(phi1);
  t5 = sinf(phi4);
  t6 = t2 / 20.0F;
  t8_tmp = t4 / 20.0F;
  t14 = t4 * 0.0105F;
  t15 = t5 * 0.0105F;
  t5 = t8_tmp - t5 / 20.0F;
  a = (t3 / 20.0F - t6) + 0.06F;
  b_a = t14 - t15;
  t4 = t3 * 0.0105F - t2 * 0.0105F;
  t5 = t5 * t5 + a * a;
  t4 = atanf(1.0F / ((t4 + 0.0126F) + t5) *
             ((t15 - t14) +
              sqrtf((b_a * b_a + (t4 + 0.0126F) * (t4 + 0.0126F)) - t5 * t5))) *
       2.0F;
  t5 = t8_tmp + sinf(t4) * 0.105F;
  t4 = (t6 + cosf(t4) * 0.105F) - 0.03F;
  pos[0] = sqrtf(t5 * t5 + t4 * t4);
  pos[1] = atan2f(t5, t4);
}

